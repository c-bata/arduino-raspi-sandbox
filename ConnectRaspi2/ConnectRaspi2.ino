int ir_out = 13;
//pcから文字列が送られてきていないときは、strにnを格納
byte str=0;

// エアコンオン（暖房）
//冷房
unsigned int dr[] = {384,186,51,46,48,137,51,46,47,141,48,46,47,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50,0};
//暖房
unsigned int dd[] = {380,189,47,46,47,141,47,46,48,141,48,46,47,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46,0};
//除湿
unsigned int dj[] = {380,188,48,46,47,141,47,46,47,141,47,46,48,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46,0};
//停止
unsigned int ds[] = {380,188,48,45,48,140,48,46,48,140,48,46,48,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47,0};
//温度を上げる
unsigned int dy[] = {374,197,39,54,40,149,40,52,42,146,45,49,41,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34,0};
//温度を下げる
unsigned int dz[] = {374,192,42,54,36,152,38,54,37,150,39,56,40,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35,0};


void setup() { 
        pinMode(ir_out, OUTPUT); 
        Serial.begin(9600);
}

// dataからリモコン信号を送信
void sendSignal(unsigned int data[256]) {
        int dataSize = sizeof(data) / sizeof(data[0]);
        for (int cnt = 0; cnt < dataSize; cnt++) {
                unsigned long len = data[cnt]*10;  // dataは10us単位でON/OFF時間を記録している
                unsigned long us = micros();
                do {
                        digitalWrite(ir_out, 1 - (cnt&1)); // cntが偶数なら赤外線ON、奇数ならOFFのまま                      
                        delayMicroseconds(8);  // キャリア周波数38kHzでON/OFFするよう時間調整
                        digitalWrite(ir_out, 0);
                        delayMicroseconds(7);
                } while (long(us + len - micros()) > 0); // 送信時間に達するまでループ
        }                   
}


void loop() {

        str=0;

        if(Serial.available() > 0){

                str = Serial.read();
                //Serial.print(str); //for debug

                if(str == 'd'){
                        sendSignal(dd);  //この関数が上手く動作してない
                }           
                else if(str == 'r'){
                        sendSignal(dr);
                }
                else if(str == 'j'){
                        sendSignal(dj);
                }   
                else if(str == 's'){
                        sendSignal(ds);
                }
                else if(str == 'y'){
                        sendSignal(dy);
                }
                else if(str == 'z'){
                        sendSignal(dz);
                }         
                else{   
                        delay(1000);
                }
        }
        delay(3000);
}
