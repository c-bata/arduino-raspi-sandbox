int ir_out = 13;
//pcから文字列が送られてきていないときは、strにnを格納
byte str=0;
int temperature = 0;

// エアコンオン（暖房）
//暖房
unsigned int dh[] = {380,189,47,46,47,141,47,46,48,141,48,46,47,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46,0};
//冷房
unsigned int dc[] = {384,186,51,46,48,137,51,46,47,141,48,46,47,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50,0};
//除湿
unsigned int dd[] = {380,188,48,46,47,141,47,46,47,141,47,46,48,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46,0};
//停止
unsigned int ds[] = {380,188,48,45,48,140,48,46,48,140,48,46,48,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47,0};


void setup() { 
        pinMode(ir_out, OUTPUT); 
        Serial.begin(9600);
}

//暖房
void heater() {
  int dataSize = sizeof(dh) / sizeof(dh[0]);
  for (int cnt = 0; cnt < dataSize; cnt++) {
    unsigned long len = dh[cnt]*10;  // dataは10us単位でON/OFF時間を記録している
    unsigned long us = micros();
    do {
      digitalWrite(ir_out, 1 - (cnt&1)); // cntが偶数なら赤外線ON、奇数ならOFFのまま
      delayMicroseconds(8);  // キャリア周波数38kHzでON/OFFするよう時間調整
      digitalWrite(ir_out, 0);
      delayMicroseconds(7);
    } while (long(us + len - micros()) > 0); // 送信時間に達するまでループ
  }
}

//冷房
void cooler() {
  int dataSize = sizeof(dc) / sizeof(dc[0]);
  for (int cnt = 0; cnt < dataSize; cnt++) {
    unsigned long len = dc[cnt]*10;  // dataは10us単位でON/OFF時間を記録している
    unsigned long us = micros();
    do {
      digitalWrite(ir_out, 1 - (cnt&1)); // cntが偶数なら赤外線ON、奇数ならOFFのまま
      delayMicroseconds(8);  // キャリア周波数38kHzでON/OFFするよう時間調整
      digitalWrite(ir_out, 0);
      delayMicroseconds(7);
    } while (long(us + len - micros()) > 0); // 送信時間に達するまでループ
  }
}

//除湿
void dehumidifier() {
  int dataSize = sizeof(dd) / sizeof(dd[0]);
  for (int cnt = 0; cnt < dataSize; cnt++) {
    unsigned long len = dd[cnt]*10;  // dataは10us単位でON/OFF時間を記録している
    unsigned long us = micros();
    do {
      digitalWrite(ir_out, 1 - (cnt&1)); // cntが偶数なら赤外線ON、奇数ならOFFのまま
      delayMicroseconds(8);  // キャリア周波数38kHzでON/OFFするよう時間調整
      digitalWrite(ir_out, 0);
      delayMicroseconds(7);
    } while (long(us + len - micros()) > 0); // 送信時間に達するまでループ
  }
}

//停止
void stop() {
  int dataSize = sizeof(ds) / sizeof(ds[0]);
  for (int cnt = 0; cnt < dataSize; cnt++) {
    unsigned long len = ds[cnt]*10;  // dataは10us単位でON/OFF時間を記録している
    unsigned long us = micros();
    do {
      digitalWrite(ir_out, 1 - (cnt&1)); // cntが偶数なら赤外線ON、奇数ならOFFのまま
      delayMicroseconds(8);  // キャリア周波数38kHzでON/OFFするよう時間調整
      digitalWrite(ir_out, 0);
      delayMicroseconds(7);
    } while (long(us + len - micros()) > 0); // 送信時間に達するまでループ
  }
}

void loop() {

        if(Serial.available() > 0){

                str = Serial.read();
                //Serial.print(str); //for debug

                if(str == 'h'){
                        heater();
                        //Raspberry Piに信号を送信するときは,文字ではなく文字列で送る。
                        Serial.println("Success");
                        str = 0;
                }
                else if(str == 'c'){
                        cooler();
                        Serial.println("Success");
                        str = 0;
                }
                else if(str == 'd'){
                        dehumidifier();
                        Serial.println("Success");
                        str = 0;
                }
                else if(str == 's'){
                        stop();
                        Serial.println("Success");
                        str = 0;
                }
                else if(str == 't'){
                        temperature = 20; //温度センサから室温を取得したとする
                        Serial.println(temperature);
                        str = 0;
                }
        }
        //delay(1000);
}
